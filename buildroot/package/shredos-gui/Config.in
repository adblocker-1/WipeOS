## buildroot/package/shredos-gui/Config.in
```kconfig
config BR2_PACKAGE_SHREDOS_GUI
	bool "shredos-gui"
	depends on BR2_PACKAGE_NWIPE
	help
	  WipeOS graphical user interface (LVGL, framebuffer):
	  create a job with customer and technician, choose drives
	  and method, run nwipe and save a PDF erasure report on
	  the WipeOS USB stick.
```
